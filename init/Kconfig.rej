## init/Kconfig.rej
```kconfig
--- init/Kconfig
+++ init/Kconfig
@@ -403,6 +403,14 @@ config AUDIT_LOGINUID_IMMUTABLE
 
 source "kernel/irq/Kconfig"
 
+config DEFAULT_ROOTWAIT_POLL
+	int "configureable option for changing rootwait polling time"
+	default 100
+	help
+		For several devices, the rootwait time is sensitive because
+		it directly affects booting time. The above config could be 
+		used configure it via device config.
+
 menu "RCU Subsystem"
 
 choice
```
